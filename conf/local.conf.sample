## meta-flex-distro/conf/distro/flex-os.conf
```bitbake
# ---------------------------------------------------------------------------------------------------------------------
# SPDX-License-Identifier: MIT
# ---------------------------------------------------------------------------------------------------------------------

## Flex OS Base Configuration {{{1
DISTRO_NAME = "Flex OS"
DISTRO_CODENAME = "scarthgap"
MAINTAINER = "Siemens Digital Industries Software <embedded_support@mentor.com>"
# TODO: Fix the URL below, the following URL is not valid
#HOME_URL = "https://www.plm.automation.siemens.com/global/en/products/embedded/flex-os.html"
SUPPORT_URL = "https://support.sw.siemens.com/"
BUG_REPORT_URL = "https://support.sw.siemens.com/"

# Distro and release versioning
YEAR_VERSION = "2024"
QUARTER_VERSION = "04"
UPDATE_VERSION = "0"
RELEASE_VERSION = "${YEAR_VERSION}.${QUARTER_VERSION}.${UPDATE_VERSION}"
DISTRO_VERSION = "${RELEASE_VERSION}"
ARCHIVE_RELEASE_VERSION = "${DISTRO_VERSION}.${BSP_VERSION}.${PATCH_VERSION}"
PDK_LICENSE_VERSION_DATE = "20230331"

# Version of the scripts artifact, including setup-flex
SCRIPTS_VERSION ?= "1"

# Default values for BSP and PATCH version, to be redefined in other layers
BSP_VERSION ?= "0"
PATCH_VERSION ?= "0"

SDK_VERSION = "${@d.getVar('DISTRO_VERSION').replace('+snapshot-${DATE}', '')}.${SDK_TIMESTAMP}"
SDK_VERSION[vardepsexclude] += "SDK_TIMESTAMP"

SDK_TIMESTAMP = "${@d.getVar('DATETIME')[:-2]}"
SDK_TIMESTAMP[doc] = "The timestamp from the DATETIME variable, without seconds."

# This is a single libc DISTRO, so exclude it from tmpdir name
TCLIBCAPPEND = ""

FLEX_DEFAULT_EXTRA_RDEPENDS = "packagegroup-core-boot"
FLEX_DEFAULT_EXTRA_RRECOMMENDS = "kernel-module-af-packet"
DISTRO_EXTRA_RDEPENDS += " ${FLEX_DEFAULT_EXTRA_RDEPENDS}"
DISTRO_EXTRA_RRECOMMENDS += " ${FLEX_DEFAULT_EXTRA_RRECOMMENDS}"

# Easier adjustment of oe-core QA check defaults
WARN_TO_ERROR_QA ??= ""
WARN_QA:remove = "${WARN_TO_ERROR_QA}"
ERROR_QA:append = " ${WARN_TO_ERROR_QA}"

# Scale down jobs/threads when memory per CPU core is low
INHERIT += "mem-per-cpu-scaling"

# Use the default oe/yocto-built toolchain
TCMODE = "default"

# We want media to auto-mount
DISTRO_EXTRA_RRECOMMENDS += "udev-extraconf"

# Paths
FLEXDIR ?= "${COREBASE}/.."

# Use a local PR server by default
PRSERV_HOST ?= "localhost:0"

# Default to ipk packaging
PACKAGE_CLASSES ?= "package_ipk"

# Flex OS's supported hosts
SANITY_TESTED_DISTROS = "\
    ubuntu-22.04 \n\
    rhel*-9* \n \
    redhatenterprise*-9* \n \
"

# Remove MACHINE from default volname
UBI_VOLNAME = "rootfs"

# Default locale for images
IMAGE_LINGUAS ?= "en-us"

# Also check for host user contamination in the rootfs
ROOTFS_POSTPROCESS_COMMAND:append = " rootfs_check_host_user_contaminated"

# Default to systemd, not sysvinit
INIT_MANAGER ?= "systemd"

# Export path variables into the devshell for convenience
OE_TOPDIR = "${TOPDIR}"
OE_WORKDIR = "${WORKDIR}"
OE_TERMINAL_EXPORTS += "OE_TOPDIR OE_WORKDIR COREBASE"

require conf/distro/include/no-static-libs.inc
require conf/distro/include/yocto-uninative.inc

INHERIT += "uninative"

# Remove SPDX creation by default
INHERIT_DISTRO:remove = "create-spdx"

## }}}1
## Mechanisms provided for user customization {{{1
# Support USER_FEATURES
INHERIT += "user_features"

# Ease adding to the SDK from a global context
TOOLCHAIN_HOST_TASK_EXTRA ?= ""
TOOLCHAIN_HOST_TASK:append = " ${TOOLCHAIN_HOST_TASK_EXTRA}"
TOOLCHAIN_TARGET_TASK_EXTRA ?= ""
TOOLCHAIN_TARGET_TASK_EXTRA:pn-buildtools-tarball = ""
TOOLCHAIN_TARGET_TASK:append = " ${TOOLCHAIN_TARGET_TASK_EXTRA}"

# Easier addition of shared state mirrors
SSTATE_MIRROR_SITES ?= ""
SSTATE_MIRRORS += "${@''.join(r'file://.* %s/PATH;downloadfilename=PATH \n' % u for u in '${SSTATE_MIRROR_SITES}'.split())}"
## }}}1
## BitBake Configuration and Behavior {{{1
# Disk Space Monitoring during the build
#
# Monitor the disk space during the build. If there is less that 1GB of space or less
# than 100K inodes in any key build location (TMPDIR, DL_DIR, SSTATE_DIR), gracefully
# shutdown the build. If there is less than 100MB or 1K inodes, perform a hard halt
# of the build. The reason for this is that running completely out of space can corrupt
# files and damages the build in ways which may not be easily recoverable.
# It's necessary to monitor /tmp, if there is no space left the build will fail
# with very exotic errors.
BB_DISKMON_DIRS ??= "\
    STOPTASKS,${TMPDIR},1G,100K \
    STOPTASKS,${DL_DIR},1G,100K \
    STOPTASKS,${SSTATE_DIR},1G,100K \
    STOPTASKS,/tmp,100M,100K \
    HALT,${TMPDIR},100M,1K \
    HALT,${DL_DIR},100M,1K \
    HALT,${SSTATE_DIR},100M,1K \
    HALT,/tmp,10M,1K"

# Support shallow git tarballs
BB_GENERATE_SHALLOW_TARBALLS ?= "1"
BB_GIT_SHALLOW ?= "1"
BB_GIT_SHALLOW_DEPTH_DEFAULT ?= "1"
BB_GIT_SHALLOW_DEPTH ??= "${@'${BB_GIT_SHALLOW_DEPTH_DEFAULT}' if not '${BB_GIT_SHALLOW_REVS}' else '0'}"
BB_GIT_SHALLOW_REVS ??= ""
## }}}1
## Distro Features & Recipe Configuration {{{1
FLEX_DEFAULT_DISTRO_FEATURES = "opengl multiarch pam"

# This violates typical MACHINE/DISTRO boundaries, but is part of Flex OS's
# supported features. If the vendor supports x11 and not wayland for its
# machines, so do we.
DISTRO_FEATURES_DEFAULT:remove = "x11"
FLEX_DEFAULT_DISTRO_FEATURES += "${@bb.utils.contains('MACHINE_FEATURES', 'x11', \
                                   bb.utils.contains('MACHINE_FEATURES', 'wayland', 'wayland', 'x11', d), 'wayland', d)}"

# Use systemd-resolved for DNS services
DISTRO_FEATURES_DEFAULT:remove = "zeroconf"

# Remove unused features from default DISTRO features list
DISTRO_FEATURES_DEFAULT:remove = "\
    3g \
    acl \
    alsa \
    bluetooth \
    nfc \
    nfs \
    pcmcia \
    usbgadget \
    vfat \
    wifi \
    xattr"

# Remove unused features from DISTRO features backfill
DISTRO_FEATURES_BACKFILL_CONSIDERED:append = "pulseaudio gobject-introspection-data"

DISTRO_FEATURES ?= "${DISTRO_FEATURES_DEFAULT} ${FLEX_DEFAULT_DISTRO_FEATURES}"

# Enable our staged fixes that are on their way upstream
DISTRO_FEATURES:append = " flex-staging"

# Use systemd as the default network manager
PACKAGECONFIG:append:pn-systemd = " resolved networkd"

# Saves us boot time, while we can parse /etc/passwd for the same functionality
PACKAGECONFIG:remove:pn-systemd = "userdb"
## }}}1
### Inherits {{{1
# We want information and history about build output
INHERIT += "buildhistory"

# Copy the image license manifest into DEPLOY_DIR_IMAGE
INHERIT += "deploy-license-manifest"

# Warn if there are available update layers which are not included in the
# current configuration
INHERIT += "flex-updates-check"

# Check PDK license
INHERIT += "${@bb.utils.contains('BBFILE_COLLECTIONS', 'flex-private', 'pdk-license', '', d)}"

# Ensure that our DISTRO_CODENAME aligns with LAYERSERIES_CORENAMES
INHERIT += "codename_is_corename"

# Use our toolchain relocation scripts
INHERIT += "${@bb.utils.contains('BBFILE_COLLECTIONS', 'flex-staging', 'toolchain_ship_relocate_sdk', '', d)}"
TOOLCHAIN_SHAR_REL_TMPL = "${LAYERDIR_flex-staging}/files/toolchain-shar-relocate.sh"
TOOLCHAIN_SHAR_EXT_TMPL = "${LAYERDIR_flex-staging}/files/toolchain-shar-extract.sh"
RELOCATE_SDK_SH ?= "${LAYERDIR_flex-staging}/files/relocate_sdk.sh"
## }}}1
## Preferences & Package Selection {{{1
# Obey our graphics image feature
SYSTEMD_DEFAULT_TARGET ?= '${@bb.utils.contains_any("IMAGE_FEATURES", ["x11-base", "graphics", "weston"], "graphical.target", "multi-user.target", d)}'

# Prefer docker-moby to docker-ce by default
PREFERRED_PROVIDER_virtual/docker = "docker-moby"

# Add extra-space to rootfs (default: 204800KB) for virtualization
IMAGE_ROOTFS_EXTRA_SPACE:append = "${@bb.utils.contains('DISTRO_FEATURES', 'virtualization', ' + 307200', '', d)}"

# Additional package groups
#
# We prefer wayland/weston, unless the vendor supports x11 but not wayland.
FEATURE_PACKAGES_flex-weston = "packagegroup-core-weston"
FEATURE_PACKAGES_x11-base ?= "packagegroup-core-x11-base"
FEATURE_PACKAGES_flex-x11 = "${FEATURE_PACKAGES_x11-base}"
FEATURE_PACKAGES_graphics += "${@bb.utils.contains('DISTRO_FEATURES', 'wayland', '${FEATURE_PACKAGES_flex-weston}', '', d)}"
FEATURE_PACKAGES_graphics += "${@bb.utils.contains('DISTRO_FEATURES', 'x11', '${FEATURE_PACKAGES_flex-x11}', '', d)}"
FEATURE_PACKAGES_virtualization  ?= "docker-moby"
FEATURE_PACKAGES_codebench-debug ?= "gdbserver strace openssh-sftp-server"

# Include nss-myhostname for sysvinit, so the hostname resolves. systemd
# includes myhostname itself.
DISTRO_EXTRA_RRECOMMENDS += "${@bb.utils.contains('DISTRO_FEATURES', 'systemd', '', 'nss-myhostname', d)}"
## }}}1
## Workarounds & Overrides {{{1
# Re-export and exclude from checksums
export WSL_INTEROP
BB_BASEHASH_IGNORE_VARS:append = " WSL_INTEROP"

# Reduce tuning specificity and increase reuse.
require conf/distro/include/flex-tuning.inc

# Disable the meta-virtualization layer inclusion warning
SKIP_META_VIRT_SANITY_CHECK = "1"
## }}}1
## Images {{{1
# We have it here because we use upstream virtualization layer without any changes
EXTRA_IMAGE_FEATURES += "${@bb.utils.contains('DISTRO_FEATURES', 'virtualization', 'virtualization', '', d)}"

# Variables to include in /etc/build in our images
IMAGE_BUILDINFO_VARS ?= "\
    DISTRO DISTRO_VERSION \
    MACHINE \
    DATETIME \
    IMAGE_BASENAME IMAGE_FEATURES CORE_IMAGE_EXTRA_INSTALL \
"
## }}}1
## SDK & Application Development Environment {{{1
# Use DEPLOY_DIR_ naming for consistency
SDK_DEPLOY:flex-os = "${DEPLOY_DIR_SDK}"
DEPLOY_DIR_SDK ?= "${DEPLOY_DIR}/sdk"

# Use distro rather than oecore
SDK_NAME_PREFIX = "${DISTRO}"

# Adjust installer name and default install path
SDK_NAME = "${SDK_NAME_PREFIX}-${SDK_VERSION}-${IMAGE_BASENAME}-${MACHINE}"
SDKPATHINSTALL = "~/${DISTRO}/sdk/${SDK_VERSION}/${IMAGE_BASENAME}-${MACHINE}"

# Set the SDK title. SDK_VERSION is left out, as it's explicitly shown in the installer
SDK_TITLE ?= "${DISTRO_NAME} ${IMAGE_BASENAME} SDK for ${MACHINE}"
SDK_TITLE:task-populate-sdk-ext:flex-os = "${DISTRO_NAME} ${IMAGE_BASENAME} Extensible SDK for ${MACHINE}"

# Define a common identifier for a unique SDK, to be set in CodeBench metadata
SDK_IDENTIFIER ?= "${SDKMACHINE}-${IMAGE_BASENAME}-${MACHINE}-${SDK_VERSION}"

# As we remove the toolchain from the sdk, naming it 'toolchain' is not
# accurate, and sdk better describes what it is anyway. We also include
# SDK_VERSION in our SDK_NAME, so no need to duplicate it here.
TOOLCHAIN_OUTPUTNAME ?= "sdk-${SDKMACHINE}-${SDK_NAME}"

# Restore the default to buildtools-tarball, as that recipe sets it with ?=
TOOLCHAIN_OUTPUTNAME:pn-buildtools-tarball = "${SDK_ARCH}-buildtools-nativesdk-standalone-${DISTRO_VERSION}"

# Add KERNEL_* to the SDK environment (unexported) for use by the user
TOOLCHAIN_TARGET_TASK_EXTRA += " sdk-env-kernelvars"

# By default, include a toolchain the SDK, but not host tools like autoconf
TOOLCHAIN_HOST_REMOVE ?= "nativesdk-packagegroup-sdk-host"
TOOLCHAIN_HOST_TASK:remove = "${TOOLCHAIN_HOST_REMOVE}"

# Include metadata for CodeBench in the SDK
SDKIMAGE_FEATURES:append = " codebench-metadata"
IMAGE_CLASSES += "sdk_codebench_metadata"

# We need to ensure we can distribute downloads for SDK builds
IMAGE_CLASSES += "archive_sdk_downloads"

# Create a 'latest' symlink for the SDK
IMAGE_CLASSES += "sdk_latest_link"
## }}}1
## Flex OS Releases {{{1
# Default image for our installers
RELEASE_IMAGE ?= "development-image"
RELEASE_ARTIFACTS ?= "layers downloads images"

# Apply any release-time srcrev lockdowns for AUTOREV recipes
include ${FLEXDIR}/${MACHINE}/conf/autorevs.conf

# LAYERDIRs for our layers, by name
INHERIT += "layerdirs"

# Populate a tree of downloads organized by layer
ARCHIVE_RELEASE_DL_DIR ?= "${DEPLOY_DIR}/release-downloads"
DL_LICENSE_INCLUDE ?= "*"
INHERIT += "archive-release-downloads"

# For our forks, also point an 'upstream' remote at upstream
FORKED_REPOS ?= ""

# Our public layers should use non-ssh URIs for their remotes
PUBLIC_REPOS ?= "meta-sokol-flex ${FORKED_REPOS}"

# Define a location for placing external artifacts to be used by the build
FLEX_EXTERNAL_ARTIFACTS ?= "${TOPDIR}/flex-external-artifacts"
## }}}1
## Includes {{{1

# ML configuration
include conf/distro/include/flex-ml.conf

# BSP related distro changes
include conf/distro/include/flex-distro.conf

# Conditional EWAOL integration using USER_FEATURES because those wouldn't
# have been added to DISTRO_FEATURES while parsing distro.conf
require ${@bb.utils.contains('USER_FEATURES', 'flex-ewaol-baremetal', 'conf/distro/include/ewaol-flex-integration.conf', '', d)}
## }}}1
# vim: set fdm=marker fdl=0 :
```

## meta-flex-distro/conf/layer.conf
```bitbake
# ---------------------------------------------------------------------------------------------------------------------
# SPDX-License-Identifier: MIT
# ---------------------------------------------------------------------------------------------------------------------

BBPATH .= ":${LAYERDIR}"
BBFILES += "\
    ${LAYERDIR}/recipes-*/*/*.bb \
    ${LAYERDIR}/recipes-*/*/*.bbappend \
"

DYNAMIC_DIRS_flex-distro = "${@' '.join(set(os.listdir('${LAYERDIR}/dynamic-layers')) & set(d.getVar('BBFILE_COLLECTIONS').split()))}"
BBFILES_DYNAMIC += "${@' '.join( \
    '%s:${LAYERDIR}/dynamic-layers/%s/recipes-*/*/*.bb %s:${LAYERDIR}/dynamic-layers/%s/recipes-*/*/*.bbappend' \
        % (layer, layer, layer, layer) \
    for layer in d.getVar('DYNAMIC_DIRS_flex-distro').split() \
)}"

BBFILE_COLLECTIONS += "flex-distro"
BBFILE_PRIORITY_flex-distro = "12"
BBFILE_PATTERN_flex-distro = "^${LAYERDIR_RE}/"
LAYERSERIES_COMPAT_flex-distro = "scarthgap"
LAYERDEPENDS_flex-distro = "core flex-common"
LAYERRECOMMENDS_flex-distro = "flex-support flex-staging"
LAYERRECOMMENDS_flex-distro += "openembedded-layer filesystems-layer networking-layer multimedia-layer"

# We have it here because we use upstream virtualization layer without any changes
FEATUREOVERRIDES .= "${@bb.utils.contains('DISTRO_FEATURES', 'virtualization', ':feature-virtualization', '', d)}"
```

## meta-flex-staging/conf/layer.conf
```bitbake
# ---------------------------------------------------------------------------------------------------------------------
# SPDX-License-Identifier: MIT
# ---------------------------------------------------------------------------------------------------------------------

BBPATH .= ":${LAYERDIR}"
BBFILES += "\
    ${LAYERDIR}/recipes-*/*/*.bb \
    ${LAYERDIR}/recipes-*/*/*.bbappend \
"

DYNAMIC_DIRS_flex-staging = "${@' '.join(set(os.listdir('${LAYERDIR}/dynamic-layers')) & set(d.getVar('BBFILE_COLLECTIONS').split()))}"
BBFILES_DYNAMIC += "${@' '.join( \
    '%s:${LAYERDIR}/dynamic-layers/%s/recipes-*/*/*.bb %s:${LAYERDIR}/dynamic-layers/%s/recipes-*/*/*.bbappend' \
        % (layer, layer, layer, layer) \
    for layer in d.getVar('DYNAMIC_DIRS_flex-staging').split() \
)}"

LAYERDIR_flex-staging = "${LAYERDIR}"
BBFILE_COLLECTIONS += "flex-staging"
BBFILE_PRIORITY_flex-staging = "10"
BBFILE_PATTERN_flex-staging = "^${LAYERDIR_RE}/"
LAYERDEPENDS_flex-staging = "core flex-common"
LAYERSERIES_COMPAT_flex-staging = "scarthgap"

# We don't want systemd and everything depending on systemd to rebuild when
# the metadata stored in os-release changes. TODO: push this to oe-core
SIGGEN_EXCLUDERECIPES_ABISAFE:append:feature-flex-staging = " os-release"

INHERIT:append = " feature_overrides"
FEATUREOVERRIDES .= "${@bb.utils.contains('DISTRO_FEATURES', 'flex-staging', ':feature-flex-staging', '', d)}"
```
