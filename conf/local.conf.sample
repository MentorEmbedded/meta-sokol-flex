## conf/local.conf.sample
```bitbake
## For additional configuration examples, see also
## oe-core/meta/conf/local.conf.sample and
## oe-core/meta/conf/local.conf.sample.extended

# Distro is set to Sokol Flex OS
DISTRO = 'sokol-flex'

# The target machine for this build. Automatically set by setup-environment
MACHINE ??= "qemux86"

# The path to the toolchains installed with CodeBench. Default value: ${FLEXDIR}/toolchains,
# where FLEXDIR is the path to your Sokol Flex OS workspace
#TOOLCHAINS_PATH ?= "${FLEXDIR}/toolchains"

# Use the oe/yocto-built toolchain rather than the external
#TCMODE:sokol-flex = "default"

# Add additional packages to images
#CORE_IMAGE_EXTRA_INSTALL += "bash"

# The EXTRA_IMAGE_FEATURES variable allows groups of packages to be added to
# the generated images. See the Sokol Flex OS User’s and Reference Manual for
# supported image features
EXTRA_IMAGE_FEATURES ?= "multilib-runtime"

# Image features for development-image
IMAGE_FEATURES_DEVELOPMENT ?= "debug-tweaks"
IMAGE_FEATURES_DEVELOPMENT:append:feature-flex-bsp = " codebench-debug ssh-server-openssh tools-profile"
EXTRA_IMAGE_FEATURES = "${IMAGE_FEATURES_DEVELOPMENT} multilib-runtime splash"

# Image features for production-image
IMAGE_FEATURES_PRODUCTION ?= ""
IMAGE_FEATURES_DISABLED_PRODUCTION ?= "${IMAGE_FEATURES_DEVELOPMENT} ssh-server-dropbear"

# Set the root password. Set to '0' to explicitly set and allow the empty root
# password even in production-image. Set to '*' to explicitly disable root
# login
#ROOT_PASSWORD = "0"
IMAGE_CLASSES:append = " image-root-password"

# Enable and disable distro features. To disable a feature, prefix it with ~
#USER_FEATURES += "~x11"

# Enable runtime testing with ptest
#USER_FEATURES += "ptest"
#EXTRA_IMAGE_FEATURES += "ptest-pkgs"

# How many tasks bitbake should run in parallel. Default: NUM_CPUS
#BB_NUMBER_THREADS ?= "${@int(oe.utils.cpu_count())}"

# How many jobs 'make' should run in parallel when compiling. Default: NUM_CPUS
#PARALLEL_MAKE ?= "-j ${@oe.utils.cpu_count()}"

# Uncomment to scale down threads and jobs when memory-per-cpu-core is low
#BB_NUMBER_THREADS = "${BB_NUMBER_THREADS_SCALED}"
#PARALLEL_MAKE = "${PARALLEL_MAKE_SCALED}"

# Download directory
DL_DIR ?= "${FLEXDIR}/downloads"

# Prebuilt binary cache
SSTATE_DIR ?= "${FLEXDIR}/cached-binaries"

# Download files from a mirror
#INHERIT += "own-mirrors"
#SOURCE_MIRROR_URL = "file:///cache/downloads"
#SOURCE_MIRROR_URL = "http://myserver/sources"

# Shared-state files from other locations
#SSTATE_MIRROR_SITES += "http://mymirror/sstate"
#SSTATE_MIRROR_SITES += "\
#    http://someserver.tld/share/sstate \
#    file:///some/local/dir \
#"

# By default, include a toolchain the SDK, but not host tools like autoconf
TOOLCHAIN_HOST_REMOVE ??= "nativesdk-packagegroup-sdk-host"
TOOLCHAIN_HOST_TASK:remove = "${TOOLCHAIN_HOST_REMOVE}"

# Add host packages to the SDK
#TOOLCHAIN_HOST_TASK_EXTRA += "nativesdk-bash"

# Add target packages to the SDK
#TOOLCHAIN_TARGET_TASK_EXTRA += "ncurses-libncurses"

# Enable source archival (to ${DEPLOY_DIR}/sources). See oe-core's
# local.conf.sample.extended for details on further configuration, including
# filtering based on license
#INHERIT += "archiver"

CONF_VERSION = "2"
```

## meta-flex-common/conf/layer.conf
```bitbake
# ---------------------------------------------------------------------------------------------------------------------
# SPDX-License-Identifier: MIT
# ---------------------------------------------------------------------------------------------------------------------

BBPATH .= ":${LAYERDIR}"

BBFILE_COLLECTIONS += "flex-common"
BBFILE_PATTERN_flex-common = "^${LAYERDIR}/"
BBFILE_PATTERN_IGNORE_EMPTY_flex-common = "1"
BBFILE_PRIORITY_flex-common = "1"
LAYERSERIES_COMPAT_flex-common = "scarthgap"
```
