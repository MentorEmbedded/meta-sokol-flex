## meta-flex-support/conf/layer.conf
```bitbake
# ---------------------------------------------------------------------------------------------------------------------
# SPDX-License-Identifier: MIT
# ---------------------------------------------------------------------------------------------------------------------

BBPATH .= ":${LAYERDIR}"
BBFILES += "\
    ${LAYERDIR}/recipes-*/*/*.bb \
    ${LAYERDIR}/recipes-*/*/*.bbappend \
"

DYNAMIC_DIRS_flex-support = "${@' '.join(set(os.listdir('${LAYERDIR}/dynamic-layers')) & set(d.getVar('BBFILE_COLLECTIONS').split())) if os.path.isdir('${LAYERDIR}/dynamic-layers') else ''}"
BBFILES_DYNAMIC += "${@' '.join( \
    '%s:${LAYERDIR}/dynamic-layers/%s/recipes-*/*/*.bb %s:${LAYERDIR}/dynamic-layers/%s/recipes-*/*/*.bbappend' \
        % (layer, layer, layer, layer) \
    for layer in d.getVar('DYNAMIC_DIRS_flex-support').split() \
)}"

BBFILE_COLLECTIONS += "flex-support"
BBFILE_PRIORITY_flex-support = "4"
BBFILE_PATTERN_flex-support = "^${LAYERDIR_RE}/"
LAYERDEPENDS_flex-support = "core flex-common"
LAYERSERIES_COMPAT_flex-support = "scarthgap"

PREFERRED_PROVIDER_virtual/nativesdk-update-alternatives ??= "nativesdk-opkg-utils"
PREFERRED_PROVIDER_chkconfig-alternatives ??= "chkconfig-alternatives"
```

## meta-sokol-flex-common/conf/layer.conf
```bitbake
# ---------------------------------------------------------------------------------------------------------------------
# SPDX-License-Identifier: MIT
# ---------------------------------------------------------------------------------------------------------------------

BBPATH .= ":${LAYERDIR}"

BBFILE_COLLECTIONS += "sokol-flex-common"
BBFILE_PATTERN_sokol-flex-common = "^${LAYERDIR}/"
BBFILE_PATTERN_IGNORE_EMPTY_sokol-flex-common = "1"
BBFILE_PRIORITY_sokol-flex-common = "1"
LAYERSERIES_COMPAT_sokol-flex-common = "kirkstone"
```

## meta-sokol-flex-distro/conf/distro/include/vendor.inc
```bitbake
inherit layerdirs

def layerdirs(d):
    dirs = {}
    for layerpath in d.getVar('BBLAYERS', True).split():
        layerconf = os.path.join(layerpath, 'conf', 'layer.conf')

        l = bb.data.init()
        l.setVar('LAYERDIR', layerpath)
        l = bb.parse.handle(layerconf, l)
        l.expandVarref('LAYERDIR')

        for layername in (l.getVar('BBFILE_COLLECTIONS', True) or '').split():
            dirs[layername] = layerpath
    return dirs

def machine_layername(d):
    machine_conf = bb.utils.which(d.getVar('BBPATH'), 'conf/machine/%s.conf' % d.getVar('MACHINE'))
    if not machine_conf:
        bb.warn('Failed to locate conf/machine/%s.conf in BBPATH' % d.getVar('MACHINE'))
    else:
        conf_layer = os.path.dirname(os.path.dirname(os.path.dirname(machine_conf)))

        dirs = layerdirs(d)
        for layername in (d.getVar('BBFILE_COLLECTIONS', True) or '').split():
            layerdir = dirs.get(layername)
            if conf_layer == layerdir:
                return layername.replace('meta-', '')

MACHINE_LAYERNAME := "${@machine_layername(d) or 'UNKNOWN'}"
VENDOR ?= "${MACHINE_LAYERNAME}"
VENDOR_CONF ?= "conf/vendor/${VENDOR}.conf"

include ${VENDOR_CONF}
```

## meta-sokol-flex-distro/conf/layer.conf
```bitbake
# ---------------------------------------------------------------------------------------------------------------------
# SPDX-License-Identifier: MIT
# ---------------------------------------------------------------------------------------------------------------------

BBPATH .= ":${LAYERDIR}"
BBFILES += "\
    ${LAYERDIR}/recipes-*/*/*.bb \
    ${LAYERDIR}/recipes-*/*/*.bbappend \
"

DYNAMIC_DIRS_sokol-flex-distro = "${@' '.join(set(os.listdir('${LAYERDIR}/dynamic-layers')) & set(d.getVar('BBFILE_COLLECTIONS').split()))}"
BBFILES_DYNAMIC += "${@' '.join( \
    '%s:${LAYERDIR}/dynamic-layers/%s/recipes-*/*/*.bb %s:${LAYERDIR}/dynamic-layers/%s/recipes-*/*/*.bbappend' \
        % (layer, layer, layer, layer) \
    for layer in d.getVar('DYNAMIC_DIRS_sokol-flex-distro').split() \
)}"

BBFILE_COLLECTIONS += "sokol-flex-distro"
BBFILE_PRIORITY_sokol-flex-distro = "12"
BBFILE_PATTERN_sokol-flex-distro = "^${LAYERDIR_RE}/"
LAYERSERIES_COMPAT_sokol-flex-distro = "scarthgap"
LAYERDEPENDS_sokol-flex-distro = "core sokol-flex-common"
LAYERRECOMMENDS_sokol-flex-distro = "sokol-flex-support sokol-flex-staging sourcery flex-private flex-cve flex-vendor-integration"
LAYERRECOMMENDS_sokol-flex-distro += "openembedded-layer filesystems-layer networking-layer multimedia-layer"

# We have it here because we use upstream virtualization layer without any changes
FEATUREOVERRIDES .= "${@bb.utils.contains('DISTRO_FEATURES', 'virtualization', ':feature-virtualization', '', d)}"
```

## meta-sokol-flex-staging/conf/layer.conf
```bitbake
# ---------------------------------------------------------------------------------------------------------------------
# SPDX-License-Identifier: MIT
# ---------------------------------------------------------------------------------------------------------------------

BBPATH .= ":${LAYERDIR}"
BBFILES += "\
    ${LAYERDIR}/recipes-*/*/*.bb \
    ${LAYERDIR}/recipes-*/*/*.bbappend \
"

DYNAMIC_DIRS_sokol-flex-staging = "${@' '.join(set(os.listdir('${LAYERDIR}/dynamic-layers')) & set(d.getVar('BBFILE_COLLECTIONS').split()))}"
BBFILES_DYNAMIC += "${@' '.join( \
    '%s:${LAYERDIR}/dynamic-layers/%s/recipes-*/*/*.bb %s:${LAYERDIR}/dynamic-layers/%s/recipes-*/*/*.bbappend' \
        % (layer, layer, layer, layer) \
    for layer in d.getVar('DYNAMIC_DIRS_sokol-flex-staging').split() \
)}"

LAYERDIR_sokol-flex-staging = "${LAYERDIR}"
BBFILE_COLLECTIONS += "sokol-flex-staging"
BBFILE_PRIORITY_sokol-flex-staging = "10"
BBFILE_PATTERN_sokol-flex-staging = "^${LAYERDIR_RE}/"
LAYERDEPENDS_sokol-flex-staging = "core sokol-flex-common"
LAYERSERIES_COMPAT_sokol-flex-staging = "mickledore"

# We don't want systemd and everything depending on systemd to rebuild when
# the metadata stored in os-release changes. TODO: push this to oe-core
SIGGEN_EXCLUDERECIPES_ABISAFE:append:feature-sokol-flex-staging = " os-release"

INHERIT:append = " feature_overrides"
FEATUREOVERRIDES .= "${@bb.utils.contains('DISTRO_FEATURES', 'sokol-flex-staging', ':feature-sokol-flex-staging', '', d)}"
```

## meta-sokol-flex-support/conf/layer.conf
```bitbake
# ---------------------------------------------------------------------------------------------------------------------
# SPDX-License-Identifier: MIT
# ---------------------------------------------------------------------------------------------------------------------

BBPATH .= ":${LAYERDIR}"
BBFILES += "\
    ${LAYERDIR}/recipes-*/*/*.bb \
    ${LAYERDIR}/recipes-*/*/*.bbappend \
"

DYNAMIC_DIRS_sokol-flex-support = "${@' '.join(set(os.listdir('${LAYERDIR}/dynamic-layers')) & set(d.getVar('BBFILE_COLLECTIONS').split())) if os.path.isdir('${LAYERDIR}/dynamic-layers') else ''}"
BBFILES_DYNAMIC += "${@' '.join( \
    '%s:${LAYERDIR}/dynamic-layers/%s/recipes-*/*/*.bb %s:${LAYERDIR}/dynamic-layers/%s/recipes-*/*/*.bbappend' \
        % (layer, layer, layer, layer) \
    for layer in d.getVar('DYNAMIC_DIRS_sokol-flex-support').split() \
)}"

BBFILE_COLLECTIONS += "sokol-flex-support"
BBFILE_PRIORITY_sokol-flex-support = "4"
BBFILE_PATTERN_sokol-flex-support = "^${LAYERDIR_RE}/"
LAYERDEPENDS_sokol-flex-support = "core sokol-flex-common"
LAYERSERIES_COMPAT_sokol-flex-support = "langdale"

PREFERRED_PROVIDER_virtual/nativesdk-update-alternatives ??= "nativesdk-opkg-utils"
PREFERRED_PROVIDER_chkconfig-alternatives ??= "chkconfig-alternatives"
```
